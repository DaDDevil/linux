## Documentation/devicetree/bindings/display/panel/boe,aa545-p-3-a0005.yaml
```yaml
# SPDX-License-Identifier: (GPL-2.0-only OR BSD-2-Clause)
%YAML 1.2
---
$id: http://devicetree.org/schemas/display/panel/boe,aa545-p-3-a0005.yaml#
$schema: http://devicetree.org/meta-schemas/core.yaml#

title: BOE AA545 P 3 A0005 AMOLED DSI panel

maintainers:
  - Thierry Reding <thierry.reding@gmail.com>
  - Sam Ravnborg <sam@ravnborg.org>

allOf:
  - $ref: panel-common.yaml#

properties:
  compatible:
    const: boe,aa545-p-3-a0005

  reg:
    maxItems: 1

  reset-gpios: true

  vddio-supply: true

  vci-supply: true

  port: true

required:
  - compatible
  - reg
  - reset-gpios
  - vddio-supply
  - vci-supply

additionalProperties: false

examples:
  - |
    #include <dt-bindings/gpio/gpio.h>

    dsi {
        #address-cells = <1>;
        #size-cells = <0>;

        panel@0 {
            compatible = "boe,aa545-p-3-a0005";
            reg = <0>;
            reset-gpios = <&tlmm 133 GPIO_ACTIVE_LOW>;
            vddio-supply = <&vreg_l12b_1p8>;
            vci-supply = <&vreg_l13b_3p0>;

            port {
                panel_in: endpoint {
                    remote-endpoint = <&dsi_out>;
                };
            };
        };
    };
```

## Documentation/devicetree/bindings/media/i2c/onsemi,sem1217s.yaml
```yaml
# SPDX-License-Identifier: (GPL-2.0-only OR BSD-2-Clause)
%YAML 1.2
---
$id: http://devicetree.org/schemas/media/i2c/onsemi,sem1217s.yaml#
$schema: http://devicetree.org/meta-schemas/core.yaml#
title: onsemi SEM1217S lens focus controller
maintainers:
  - DaDDevil <hexiaoshan520@gmail.com>
description: |
  SEM1217S controls a voice-coil focus actuator and optical stabilization.
  The focus interface is controlled over I2C.
properties:
  compatible:
    const: onsemi,sem1217s
  reg:
    maxItems: 1
  vio-supply:
    description: I/O supply
  vdd-supply:
    description: Controller supply
  vaf-supply:
    description: Focus actuator supply
required:
  - compatible
  - reg
  - vio-supply
  - vdd-supply
  - vaf-supply
additionalProperties: false
examples:
  - |
    i2c {
        #address-cells = <1>;
        #size-cells = <0>;
        lens@61 {
            compatible = "onsemi,sem1217s";
            reg = <0x61>;
            vio-supply = <&vreg_1p8>;
            vdd-supply = <&vreg_2p8>;
            vaf-supply = <&vreg_af_2p8>;
        };
    };
```

## Documentation/devicetree/bindings/media/i2c/sony,imx581.yaml
```yaml
# SPDX-License-Identifier: (GPL-2.0-only OR BSD-2-Clause)
%YAML 1.2
---
$id: http://devicetree.org/schemas/media/i2c/sony,imx581.yaml#
$schema: http://devicetree.org/meta-schemas/core.yaml#

title: Sony IMX581 image sensor

maintainers:
  - DaDDevil <hexiaoshan520@gmail.com>

description:
  Sony IMX581 is an 8000 by 6000 pixel CMOS image sensor. This binding
  describes a three-trio CSI-2 C-PHY connection with a 19.2 MHz input clock.

allOf:
  - $ref: /schemas/media/video-interface-devices.yaml#

properties:
  compatible:
    const: sony,imx581

  reg:
    maxItems: 1

  clocks:
    maxItems: 1

  power-domains:
    maxItems: 1

  avdd-supply:
    description: Analog power supply.

  dvdd-supply:
    description: Digital core power supply.

  dovdd-supply:
    description: Digital interface power supply.

  auxvdd-supply:
    description: Auxiliary power supply for the camera module.

  afvdd-supply:
    description: Power supply for the camera module autofocus circuit.

  reset-gpios:
    description: Active-low sensor reset.
    maxItems: 1

  port:
    $ref: /schemas/graph.yaml#/$defs/port-base
    additionalProperties: false
    properties:
      endpoint:
        $ref: /schemas/media/video-interfaces.yaml#
        unevaluatedProperties: false
        properties:
          bus-type:
            const: 1 # MEDIA_BUS_TYPE_CSI2_CPHY

          data-lanes:
            items:
              - const: 0
              - const: 1
              - const: 2
        required:
          - bus-type
          - data-lanes
          - link-frequencies
    required:
      - endpoint

required:
  - compatible
  - reg
  - clocks
  - avdd-supply
  - dvdd-supply
  - dovdd-supply
  - auxvdd-supply
  - afvdd-supply
  - port

unevaluatedProperties: false

examples:
  - |
    #include <dt-bindings/gpio/gpio.h>

    i2c {
        #address-cells = <1>;
        #size-cells = <0>;

        camera@1a {
            compatible = "sony,imx581";
            reg = <0x1a>;
            clocks = <&cam_mclk>;
            reset-gpios = <&gpio 14 GPIO_ACTIVE_LOW>;
            avdd-supply = <&cam_avdd>;
            dvdd-supply = <&cam_dvdd>;
            dovdd-supply = <&cam_dovdd>;
            auxvdd-supply = <&cam_auxvdd>;
            afvdd-supply = <&cam_afvdd>;
            port {
                endpoint {
                    bus-type = <1>;
                    data-lanes = <0 1 2>;
                    link-frequencies = /bits/ 64 <1422400000>;
                    remote-endpoint = <&csiphy_in>;
                };
            };
        };
    };
```
